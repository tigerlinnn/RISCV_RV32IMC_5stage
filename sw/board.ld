/* ============================================================================
 * board.ld — RISCV_1 上跑 CoreMark 用的链接脚本
 * ----------------------------------------------------------------------------
 * 它只回答一件事：每段东西摆在存储器的哪个地址。
 *
 * 存储器共 32KB（8192 个字），地址范围 0x0000_0000 ~ 0x0000_7FFF：
 *
 *   0x0000  +--------------------+
 *           |  代码 .text        |  <- 必须排最前，因为硬件复位后 PC = 0
 *           |  .rodata           |
 *           |  .data （带初值）  |
 *           |  .bss  （无初值）  |  <- __bss_start / __bss_end 标出它的范围
 *           |       ...          |
 *           |   栈（向下生长）   |  <- _stack_top 是栈顶
 *   0x8000  +--------------------+
 * ========================================================================== */

OUTPUT_ARCH("riscv")
ENTRY(_start)

SECTIONS
{
    . = 0x00000000;

    /* ---- 代码：.text.init 必须排最前面（_start 要在地址 0）---- */
    .text : ALIGN(4) {
        *(.text.init)
        *(.text .text.*)
    }

    /* ---- 只读数据：字符串常量、查表用的常量数组等 ---- */
    .rodata : ALIGN(4) {
        *(.rodata .rodata.*)
        *(.srodata .srodata.*)
    }

    /* ---- 有初值的全局变量（CoreMark 的 seed、已知 CRC 表等）----
     *   它们的初值已经随 .hex 一起装进存储器了，启动代码不用搬。 */
    .data : ALIGN(4) {
        *(.data .data.*)
        *(.sdata .sdata.*)
    }

    /* ---- 无初值的全局变量：只占位置，初值由启动代码清零 ----
     *   这里放两块"路牌"，start.S 会读它们来找到要清的地址范围。 */
    . = ALIGN(4);
    __bss_start = .;
    .bss : ALIGN(4) {
        *(.bss .bss.*)
        *(.sbss .sbss.*)
        *(COMMON)
    }
    . = ALIGN(4);
    __bss_end = .;

    /* ---- 栈 ----
     *   栈从存储器末尾往下生长，所以"栈顶"就是最高地址。
     *   要求：
     *     - CoreMark 的 stack_memblock 约 2KB
     *     - ee_printf 里有一个 1KB 的局部缓冲区
     *     - 再加上普通的调用栈
     *   所以至少留 8KB 比较稳。 */
    . = ALIGN(16);
    _stack_top  = 0x00008000;
    __stack_top = _stack_top;

    /* ---- 安全检查：代码+数据+bss 不能长到吃掉栈空间 ----
     *   0x8000 - 0x2000 = 0x6000，也就是至少给栈留 8KB。 */
    ASSERT(. <= 0x00006000,
           "程序太大：代码+数据+bss 已超过 24KB，没给 8KB 栈留够地方")

    /DISCARD/ : { *(.comment) *(.note*) }
}
